## config/west.yml
```yaml
manifest:
  remotes:
    - name: tsang
      url-base: https://github.com/tsang
  projects:
    - name: zmk
      remote: tsang
      revision: caksoylar/zen+969+1098+mouse
      import: app/west.yml
  self:
    path: config
```
